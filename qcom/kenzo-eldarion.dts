/dts-v1/;

#include "msm8956.dtsi"
#include "msm8956-mtp.dtsi"
#include "pmi8950.dtsi"
#include "msm8976-mdss-panels.dtsi"

#include "../../../../../../techpack/xiaomi-eldarion/kernel/dts/xiaomi-eldarion/common/common.dtsi"
#include "../../../../../../techpack/xiaomi-eldarion/kernel/dts/xiaomi-eldarion/kenzo/kenzo.dtsi"

/ {
	model = "Qualcomm Technologies, Inc. MSM8956 MTP";
	compatible = "qcom,msm8956-mtp", "qcom,msm8956", "qcom,mtp";
	qcom,board-id= <8 0>;
};
